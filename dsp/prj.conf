## CMakeLists.txt
```
# SPDX-License-Identifier: Apache-2.0

cmake_minimum_required(VERSION 3.20.0)

find_package(Zephyr REQUIRED HINTS $ENV{ZEPHYR_BASE})
project(dsp)

FILE(GLOB app_sources src/main.c)

# Collect all the source files in lib. Note that
# the path given needs to be relative to the
# CMakeLists root, which is app/prac2 here,
# hence the ../../lib.c.
FILE(GLOB lib_sources lib/bluetooth/bluetooth.c)

# Tell CMake to build with the app and lib sources
target_sources(app PRIVATE ${app_sources} ${lib_sources})

# Tell CMake where our header files are
target_include_directories(app PRIVATE lib/bluetooth)
```

## prj.conf
```kconfig
# GPIO Stuff
CONFIG_GPIO=y

CONFIG_PM=y

# Audio Stuff
CONFIG_AUDIO=y
CONFIG_AUDIO_DMIC=y
CONFIG_AUDIO_DMIC_NRFX_PDM=y

CONFIG_PRINTK=y

# LOG Stuff
CONFIG_LOG=y
CONFIG_CBPRINTF_FP_SUPPORT=y
CONFIG_SEGGER_RTT_BUFFER_SIZE_UP=4096

#RTT Stuff
CONFIG_USE_SEGGER_RTT=y
CONFIG_UART_CONSOLE=n
CONFIG_UART_RTT=y
CONFIG_RTT_CONSOLE=y

#Bluetooth Stuff
CONFIG_BT=y
CONFIG_BT_PERIPHERAL=y
CONFIG_BT_GATT_CLIENT=y
CONFIG_BT_DEVICE_NAME="BT_NUS_PERIPHERAL"
CONFIG_BT_MAX_CONN=1

# FFT Stuff
CONFIG_CMSIS_DSP=y
CONFIG_CMSIS_DSP_COMPLEXMATH=y
CONFIG_CMSIS_DSP_TRANSFORM=y
CONFIG_CMSIS_DSP_FILTERING=y
CONFIG_CMSIS_DSP_FASTMATH=y
```

## boards/thingy52_nrf52832.overlay
```dts
&pinctrl {
	pdm0_default_alt: pdm0_default_alt {
		group1 {
			psels = <NRF_PSEL(PDM_CLK, 0, 26)>,
				<NRF_PSEL(PDM_DIN, 0, 25)>;
		};
	};
};

dmic_dev: &pdm0 {
	status = "okay";
	pinctrl-0 = <&pdm0_default_alt>;
	pinctrl-names = "default";
};
```

## src/main_ble.c
```c
#include <zephyr/kernel.h>
#include "bluetooth.h"

int main(void)
{
    init_bluetooth();

    while (1) {
        k_sleep(K_SECONDS(1));
    }
    return 0;
}
```
